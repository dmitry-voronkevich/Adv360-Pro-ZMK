  ZMK_MACRO(mF1,
      bindings = <&kp F1>, <&tog FN_T>;
  )
  ZMK_MACRO(mF2,
      bindings = <&kp F2>, <&tog FN_T>;
  )
  ZMK_MACRO(mF3,
      bindings = <&kp F3>, <&tog FN_T>;
  )
  ZMK_MACRO(mF4,
      bindings = <&kp F4>, <&tog FN_T>;
  )
  ZMK_MACRO(mF5,
      bindings = <&kp F5>, <&tog FN_T>;
  )
  ZMK_MACRO(mF6,
      bindings = <&kp F6>, <&tog FN_T>;
  )
  ZMK_MACRO(mF7,
      bindings = <&kp F7>, <&tog FN_T>;
  )
  ZMK_MACRO(mF8,
      bindings = <&kp F8>, <&tog FN_T>;
  )
  ZMK_MACRO(mF9,
      bindings = <&kp F9>, <&tog FN_T>;
  )
  ZMK_MACRO(mF10,
      bindings = <&kp F10>, <&tog FN_T>;
  )
  ZMK_MACRO(mF11,
      bindings = <&kp F11>, <&tog FN_T>;
  )
  ZMK_MACRO(mF12,
      bindings = <&kp F12>, <&tog FN_T>;
  )
  ZMK_MACRO(macro_email,
      wait-ms = <5>;
      tap-ms = <25>;
      bindings = <&kp D &kp M &kp I &kp T &kp R &kp Y &kp DOT &kp V &kp O &kp R &kp O &kp N &kp K &kp E &kp V &kp I &kp C &kp H &kp AT &kp G &kp M &kp A &kp I &kp L &kp DOT &kp C &kp O &kp M>;

  )
  macro_quotes: macro_quotes {
    compatible = "zmk,behavior-macro";
    label = "macro_quotes";
    #binding-cells = <0>;
    bindings = <&kp SQT>, <&kp SQT>, <&kp LEFT>;
  };
  macro_dquotes: macro_dquotes {
    compatible = "zmk,behavior-macro";
    label = "macro_dquotes";
    #binding-cells = <0>;
    bindings = <&kp DQT>, <&kp DQT>, <&kp LEFT>;
  };
  macro_braces: macro_braces {
    compatible = "zmk,behavior-macro";
    label = "macro_braces";
    #binding-cells = <0>;
    bindings = <&kp LBRC>, <&kp RBRC>, <&kp LEFT>;
  };
  macro_parens: macro_parens {
    compatible = "zmk,behavior-macro";
    label = "macro_parens";
    #binding-cells = <0>;
    bindings = <&kp LPAR>, <&kp RPAR>, <&kp LEFT>;
  };
  macro_brackets: macro_brackets {
    compatible = "zmk,behavior-macro";
    label = "macro_brackets";
    #binding-cells = <0>;
    bindings = <&kp LBKT>, <&kp RBKT>, <&kp LEFT>;
  };
  macro_kinesis: macro_kinesis {
    compatible = "zmk,behavior-macro";
    label = "macro_kinesis";
    #binding-cells = <0>;
    bindings = <&kp LS(K)>, <&kp I>, <&kp N>, <&kp E>, <&kp S>, <&kp I>, <&kp S>;
  };
